#include "lcd1602.h"
	
void delay_ms(unsigned int ms){
	unsigned int a,b;
	for(a=ms;a>0;a--)
	for(b=123;b>0;b--);
}
/*******************************************************************
功能描述：LCD1602写命令函数 
********************************************************************/
void lcd_wcom(uint8 com)                 
{ 
    lcd1602_rs=0;              
    lcd1602_rw=0;
    LCDDATA=com;                   
    delay_ms(1);       

    lcd1602_en=1;           
    lcd1602_en=0;            
} 

/*******************************************************************
功能描述：LCD1602写数据函数 
********************************************************************/
void lcd_wdat(uint8 dat)          
{ 
    lcd1602_rs=1;             
    lcd1602_rw=0;               
    LCDDATA=dat;                     
    delay_ms(1);                
	
    lcd1602_en=1;               
    lcd1602_en=0;            
} 

/*******************************************************************
功能描述：LCD1602初始化函数 
********************************************************************/
void lcd_init(void)                 
{ 
    lcd_wcom(0x3c);          
    lcd_wcom(0x0c);       //开启显示屏
    lcd_wcom(0x06);       //显示地址递增，即写一个数据后，显示位置右移一位 
    lcd_wcom(0x01);       //清屏 
} 		

/*******************************************************************
功能描述：LCD1602按指定位置显示一个字符
********************************************************************/
void DisplayOneChar(uint8 X, uint8 Y, uint8 DData)
{
	Y &= 0x1;
	X &= 0xF; //限制X不能大于15，Y不能大于1
	if (Y) X |= 0x40; //当要显示第二行时地址码+0x40;
	X |= 0x80; //算出指令码
	lcd_wcom(X); //发命令字
	lcd_wdat(DData); //发数据
}

/*******************************************************************
功能描述：LCD1602按指定位置显示一串字符
入口参数：uint8 X, uint8 Y, uint8 DData  X代表第X+1列，Y代表第Y+1行
********************************************************************/
void DisplayListChar(uint8 X, uint8 Y, uint8 code *DData)
{
	uint8 ListLength;

  ListLength = 0;
	Y &= 0x1;
	X &= 0xF; //限制X不能大于15，Y不能大于1
	while (DData[ListLength]>0x19) //若到达字串尾则退出
		{
			if (X <= 0xF)        //X坐标应小于0xF
				{
					DisplayOneChar(X, Y, DData[ListLength]); //显示单个字符
					ListLength++;
					X++;
				}
		}
}
bit LCD_Check_Busy(void) 
 { 
 	LCDDATA= 0xFF; 
	lcd1602_rs=0; 
 	lcd1602_rw=1; 
	lcd1602_en=0; 
 	delay_ms(1); 
 	lcd1602_en=1;
 	return (bit)(LCDDATA & 0x80);
 }
/*********************************END FILE********************************************/	

